## conf/layer.conf
```bitbake
# SPDX-License-Identifier: BSD-3-Clause
# Copyright 2023 NXP
# We have a conf and classes directory, append to BBPATH
BBPATH .= ":${LAYERDIR}"

#LICENSE_FLAGS_ACCEPTED += "commercial_gstreamer1.0-plugins-ugly license_emgd_1.10 commercial_libav commercial_gstreamer1.0-libav commercial_x264 commercial_lame commercial_libmad commercial_mpeg2dec"

# We have a recipes directory, add to BBFILES
BBFILES += "${LAYERDIR}/recipes-*/*/*.bb ${LAYERDIR}/recipes-*/*/*.bbappend"

BBFILE_COLLECTIONS += "nxp-web-ui"
BBFILE_PATTERN_nxp-web-ui := "^${LAYERDIR}/"
BBFILE_PRIORITY_nxp-web-ui = "7"

LAYERVERSION_nxp-web-ui = "1"
LAYERSERIES_COMPAT_nxp-web-ui = "langdale mickledore nanbield scarthgap styhead walnascar whinlatter"

# For avdec_h264 and avdec_aac
LICENSE_FLAGS_ACCEPTED += "commercial"
```
